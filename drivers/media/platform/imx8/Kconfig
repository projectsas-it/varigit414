## drivers/media/platform/imx8/Kconfig
```kconfig
if VIDEO_MX8_CAPTURE
menu "IMX8 Camera ISI/MIPI Features support"

config IMX8_MIPI_CSI2_YAV
	tristate "IMX8 MIPI CSI2 Controller Yet Another Version"
	select V4L2_FWNODE
	default y

config IMX8_JPEG
	tristate "IMX8 JPEG Encoder/Decoder"
	depends on VIDEO_V4L2 && VIDEO_V4L2_SUBDEV_API
	select V4L2_MEM2MEM_DEV
	select VIDEOBUF2_DMA_CONTIG
	default m

config MXC_CAMERA_AR1335_AF
        tristate "AR1335 Auto focus Camera driver support"
        depends on I2C && VIDEO_ECAM
        default y
        help
          Enable support for video4linux camera sensor driver for eCAM136_IMX8
endmenu
endif #VIDEO_MX8_CAPTURE
```
