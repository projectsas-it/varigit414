/*
 *  Devicetree for a Basler camera on Variscite VAR-SOM-MX8M-MINI
 *
 *  Created by Hauke Wulff on 23.07.19.
 *  Copyright (c) 2019 Basler AG. All rights reserved.
 *  Copyright 2020-2021 Variscite Ltd.
 *
 */

#include "imx8mm-var-som-symphony.dts"
#include "imx8mm-var-som-symphony-basler.dtsi"

/ {
	model = "Variscite VAR-SOM-MX8M-MINI on Symphony-Board 1.4a and above with Basler camera";
};
