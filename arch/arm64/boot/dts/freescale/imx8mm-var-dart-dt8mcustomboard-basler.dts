/*
 *  Devicetree for a Basler camera on Variscite DART-MX8M-MINI
 *
 *  Created by Hauke Wulff on 23.07.19.
 *  Copyright (c) 2019 Basler AG. All rights reserved.
 *  Copyright 2020-2021 Variscte Ltd.
 *
 */

#include "imx8mm-var-dart-dt8mcustomboard.dts"
#include "imx8mm-var-dart-dt8mcustomboard-basler.dtsi"

/ {
	model = "Variscite DART-MX8M-MINI on DT8MCustomBoard 2.x with Basler camera";
};

&i2c4 {
	pca6408_1: gpio@20 {
		cam_pwr_hog {
			gpio-hog;
			gpios = <3 0>;
			output-high;
			line-name = "basler_cam_pwr";
		};
	};
};
